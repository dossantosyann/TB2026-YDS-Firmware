/**
 * @file gfx.c
 *
 * @note Développé avec l'assistance de Claude Opus 4.8 (Anthropic), sous la
 *       direction de Y. Dos Santos : spécification, revue et validation sur
 *       cible par l'auteur.
 */
#include "gfx.h"
#include "display_oled.h"
#include "esp_attr.h"

/* 62 KB framebuffer lives in PSRAM (EXT_RAM_BSS_ATTR) to keep internal DRAM free for the
   Bluetooth stack. The SPI flush reads it pixel-by-pixel on the CPU and DMAs from an internal
   line buffer, so PSRAM here costs only slower CPU access, never a DMA-from-PSRAM issue. */
EXT_RAM_BSS_ATTR static gfx_color_t s_fb[GFX_W * GFX_H];

const gfx_color_t *gfx_buffer(void)
{
    return s_fb;
}

void gfx_clear(gfx_color_t color)
{
    for (int i = 0; i < GFX_W * GFX_H; i++) s_fb[i] = color;
}

void gfx_pixel(int x, int y, gfx_color_t color)
{
    if (x < 0 || x >= GFX_W || y < 0 || y >= GFX_H) return;
    s_fb[y * GFX_W + x] = color;
}

void gfx_fill_rect(int x, int y, int w, int h, gfx_color_t color)
{
    /* Clip to the canvas so an off-screen rect can never write out of bounds. */
    if (x < 0) { w += x; x = 0; }
    if (y < 0) { h += y; y = 0; }
    if (x + w > GFX_W) w = GFX_W - x;
    if (y + h > GFX_H) h = GFX_H - y;
    for (int j = 0; j < h; j++) {
        gfx_color_t *row = &s_fb[(y + j) * GFX_W + x];
        for (int i = 0; i < w; i++) row[i] = color;
    }
}

void gfx_draw_rect(int x, int y, int w, int h, gfx_color_t color)
{
    if (w <= 0 || h <= 0) return;
    gfx_fill_rect(x, y, w, 1, color);           /* top    */
    gfx_fill_rect(x, y + h - 1, w, 1, color);   /* bottom */
    gfx_fill_rect(x, y, 1, h, color);           /* left   */
    gfx_fill_rect(x + w - 1, y, 1, h, color);   /* right  */
}

/* Proven 5x7 font (validated on the panel) for ASCII 0x20..0x7E,
   column-major with bit 0 = the top row. */
#define GFX_FONT_W 5
#define GFX_FONT_H 7
static const uint8_t s_font[95][GFX_FONT_W] = {
    {0x00,0x00,0x00,0x00,0x00},{0x00,0x00,0x5F,0x00,0x00},{0x00,0x07,0x00,0x07,0x00},
    {0x14,0x7F,0x14,0x7F,0x14},{0x24,0x2A,0x7F,0x2A,0x12},{0x23,0x13,0x08,0x64,0x62},
    {0x36,0x49,0x55,0x22,0x50},{0x00,0x05,0x03,0x00,0x00},{0x00,0x1C,0x22,0x41,0x00},
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    {0x00,0x41,0x36,0x08,0x00},{0x08,0x04,0x08,0x10,0x08},
};

void gfx_draw_text(int x, int y, const char *s, gfx_color_t color, int scale)
{
    if (scale < 1) scale = 1;
    for (; *s; s++) {
        unsigned char ch = (unsigned char)*s;
        if (ch >= 0x20 && ch <= 0x7E) {
            const uint8_t *g = s_font[ch - 0x20];
            for (int col = 0; col < GFX_FONT_W; col++)
                for (int row = 0; row < GFX_FONT_H; row++)
                    if ((g[col] >> row) & 1)
                        gfx_fill_rect(x + col * scale, y + row * scale, scale, scale, color);
        }
        x += GFX_CHAR_W * scale;     /* 5px glyph + 1px gap, scaled */
    }
}

void gfx_blit_1bpp(int x, int y, int w, int h, const uint8_t *bitmap, gfx_color_t color)
{
    const int stride = (w + 7) / 8;     /* bytes per row, matching icon2c.py */
    for (int row = 0; row < h; row++) {
        const uint8_t *line = &bitmap[row * stride];
        for (int col = 0; col < w; col++)
            if ((line[col >> 3] >> (7 - (col & 7))) & 1)
                gfx_pixel(x + col, y + row, color);     /* gfx_pixel clips to the canvas */
    }
}

void gfx_flush(void)
{
    /* The framebuffer is native RGB565; display_oled_draw byte-swaps each pixel into
       its own internal DMA-capable line buffer, so PSRAM never feeds the SPI DMA. */
    display_oled_draw((const uint8_t *)s_fb, sizeof s_fb);
}
