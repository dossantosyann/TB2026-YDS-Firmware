## sdkconfig.defaults
```kconfig
# Module ESP32-WROVER-E N16R8: 16MB flash + 8MB quad PSRAM
CONFIG_ESPTOOLPY_FLASHSIZE_16MB=y
CONFIG_SPIRAM=y
# Allow static .bss in PSRAM (EXT_RAM_BSS_ATTR) so the 62 KB OLED framebuffer moves off
# internal DRAM, which the Bluetooth stack needs.
CONFIG_SPIRAM_ALLOW_BSS_SEG_EXTERNAL_MEMORY=y
CONFIG_BT_ENABLED=y
CONFIG_BT_CLASSIC_ENABLED=y
CONFIG_BT_A2DP_ENABLE=y
CONFIG_BT_AVRCP_ENABLED=y
# A2DP source needs the radio controller in BR/EDR (classic); the default was BLE-only.
# Classic-only also frees the BLE RAM (no BLE feature in this project).
CONFIG_BTDM_CTRL_MODE_BR_EDR_ONLY=y
CONFIG_BT_BLE_ENABLED=n
CONFIG_FATFS_LFN_HEAP=y
CONFIG_FATFS_MAX_LFN=255
# Custom partition table (partitions.csv): 4MB app instead of the 1MB default.
CONFIG_PARTITION_TABLE_CUSTOM=y
# Task watchdog panics (resets) instead of just logging when a subscribed task fails to
# feed within the 5 s timeout. Tasks subscribe dynamically only where a stalled loop is a
# real softlock (audio decode, live UI render); event-driven tasks that block by design stay
# unsubscribed. Idle-task checks (both cores) stay on: a CPU-bound spin is caught too.
CONFIG_ESP_TASK_WDT_PANIC=y
# Core dump to the dedicated 128K flash partition (ELF) on panic. Written by the panic
# handler before the reset drops the self-held rail, it is the only crash witness that
# survives a power-off; the boot sequence copies it to the SD card, then erases it
# (see coredump_export in app.c and power_boot_off_check in power.c).
CONFIG_ESP_COREDUMP_ENABLE_TO_FLASH=y
# Power management: DFS (esp_pm_configure 80<->160 MHz in app_init). Drivers take
# APB/CPU locks while active, so audio is unaffected. No tickless/light sleep: it
# would stop I2S, and the BT low-power clock needs a 32 kHz crystal we don't have.
CONFIG_PM_ENABLE=y

# Diagnostics campaign (components/services/diag, off): re-enable DIAG_ENABLED in diag.h
# together with CONFIG_FREERTOS_USE_TRACE_FACILITY, _USE_STATS_FORMATTING_FUNCTIONS,
# _GENERATE_RUN_TIME_STATS and _VTASKLIST_INCLUDE_COREID. They stay out of the shipping
# build: the trace facility widens every TCB and the run-time stats read a counter on
# every context switch. (Stack-overflow checking stays at its IDF default, Canary.)
```
